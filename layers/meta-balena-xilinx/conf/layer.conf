## layers/meta-balena-xilinx/conf/layer.conf
```bitbake
BBPATH .= ":${LAYERDIR}"

BBFILES += "${LAYERDIR}/recipes-*/*/*.bb \
            ${LAYERDIR}/recipes-*/*/*.bbappend"

BBFILE_COLLECTIONS += "balena-xilinx"
BBFILE_PATTERN_balena-xilinx := "^${LAYERDIR}/"
BBFILE_PRIORITY_resin_xilinx = "1337"

LAYERSERIES_COMPAT_balena-xilinx = "rocko"
```

## layers/meta-balena-xilinx/conf/machine/ge-189408.conf
```bitbake
#@TYPE: Machine
#@NAME: GE-189408
#@DESCRIPTION: GE-189408 hardware

MACHINEOVERRIDES = "zcu102-zynqmp:${MACHINE}"
include conf/machine/zcu102-zynqmp.conf
```

## layers/meta-resin-xilinx/conf/layer.conf
```bitbake
BBPATH .= ":${LAYERDIR}"

BBFILES += "${LAYERDIR}/recipes-*/*/*.bb \
            ${LAYERDIR}/recipes-*/*/*.bbappend"

BBFILE_COLLECTIONS += "resin-xilinx"
BBFILE_PATTERN_resin-xilinx := "^${LAYERDIR}/"
BBFILE_PRIORITY_resin_xilinx = "1337"

LAYERSERIES_COMPAT_resin-xilinx = "rocko"
```
